## project/test_timer/Kconfig
```kconfig
#
# For a description of the syntax of this configuration file,
# see Documentation/kbuild/kconfig-language.txt.
#

mainmenu "Project Configuration"

config PROJECT_MODULE_DEFINED
    bool
    default y
    select HAVE_LCD
    select HAVE_GRAPHICS
    select HAVE_AUDIO
    select HAVE_VIDEO
    
config DEF_CHIP_PKG_IT9856
    def_bool y
    
config RAM_INIT_SCRIPT
    default "IT9850A0_360MHz.scr"
    
config DBG_INIT_SCRIPT
	default "IT9850A0_400MHz.txt"
    
config GPIO_UART1_TX
    default "4"

config CMAKE_SOURCE_DIR
    string
    option env="CMAKE_SOURCE_DIR"

source "$CMAKE_SOURCE_DIR/sdk/Kconfig"
```
